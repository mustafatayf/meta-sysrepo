## conf/layer.conf
```bitbake
# We have a conf and classes directory, append to BBPATH
BBPATH .= ":${LAYERDIR}"

# We have a recipes directory, add to BBFILES
BBFILES += "${LAYERDIR}/recipes*/*/*.bb ${LAYERDIR}/recipes*/*/*.bbappend"

BBFILE_COLLECTIONS += "netopeer2"
BBFILE_PATTERN_netopeer2 = "^${LAYERDIR}/"
BBFILE_PRIORITY_netopeer2 = "7"

#
LAYERSERIES_COMPAT_netopeer2 = "langdale"

# Set a variable to get to the top of the metadata location
MPBASE := '${@os.path.normpath("${LAYERDIR}/../")}'

LICENSE_PATH += "${LAYERDIR}/licenses"

LAYERDEPENDS_netopeer2 = "openembedded-layer"

SIGGEN_EXCLUDERECIPES_ABISAFE += " \
    gstreamer1.0-plugins-bad \
"
```
